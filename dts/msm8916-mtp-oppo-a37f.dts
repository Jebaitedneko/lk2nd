// SPDX-License-Identifier: GPL-2.0-only

/dts-v1/;

/include/ "msm8916.dtsi"

/ {
  compatible = "qcom,msm8916-mtp", "qcom,msm8916", "qcom,msm";
	qcom,msm-id = < 0xce 0x00 0xf8 0x00 0xf9 0x00 0xfa 0x00 >;
	qcom,board-id = <0x8 0x0 15399>
  
	a37f {
		model = "oppo A37f;
		compatible = "oppo,a37f", "qcom,msm8916-mtp", "qcom,msm8916", "qcom,msm", "qcom,mtp", "lk2nd,device";
		lk2nd,match-cmdline = "* mdss_mdp.panel=1:dsi:0:qcom,mdss_dsi_oppo15399tm_nt35521s_720p_video:1:qcom,mdss_dsi_oppo15399boe_ili9881c_720p_video:2:qcom,mdss_dsi_oppo15399truly_nt35521s_720p_video:3:none";
	};
  
};
